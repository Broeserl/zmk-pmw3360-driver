## dts/bindings/behaviors/zmk,behavior-pmw3360-cpi-dec.yml
```yaml
description: Decrease PMW3360 sensor CPI

compatible: "zmk,behavior-pmw3360-cpi-dec"

include: zero_param.yaml

properties:
  "#binding-cells":
    type: int
    required: true
    const: 0
```

## dts/bindings/behaviors/zmk,behavior-pmw3360-cpi-inc.yml
```yaml
description: Increase PMW3360 sensor CPI

compatible: "zmk,behavior-pmw3360-cpi-inc"

include: zero_param.yaml

properties:
  "#binding-cells":
    type: int
    required: true
    const: 0
```

## dts/bindings/behaviors/zmk,behavior-pmw3360-cpi-reset.yml
```yaml
description: Reset PMW3360 sensor CPI to default value

compatible: "zmk,behavior-pmw3360-cpi-reset"

include: zero_param.yaml

properties:
  "#binding-cells":
    type: int
    required: true
    const: 0
```

## src/Kconfig
```kconfig
# Sensor data simulator
#
# Copyright (c) 2019 Nordic Semiconductor
#
# SPDX-License-Identifier: LicenseRef-Nordic-5-Clause
#

menuconfig PMW3360
    bool "PMW3360 mouse optical sensor"
    select SPI
    help
      Enable PMW3360 mouse optical sensor.

if PMW3360

choice PMW3360_OPERATING_MODE
    prompt "PMW3360 operating mode"
    default PMW3360_INTERRUPT_DIRECT
    help
      Select the operating mode for the PMW3360 driver.

config PMW3360_INTERRUPT_DIRECT
    bool "Direct interrupt handling mode"
    help
      In this mode, the sensor interrupt directly triggers data reporting.
      This is the basic implementation with immediate response.

config PMW3360_INTERRUPT_POLLING
    bool "Timer-based polling mode"
    help
      In this mode, sensor interrupts trigger a timer that polls the sensor
      multiple times. This can improve tracking reliability with multiple
      samples after motion is detected.
endchoice

config PMW3360_POLLING_INTERVAL_MS
    int "Polling interval in milliseconds"
    default 15
    range 1 100
    depends on PMW3360_INTERRUPT_POLLING
    help
      Interval between polling events in milliseconds when using timer-based polling mode.

config PMW3360_MAX_POLL_COUNT
    int "Maximum number of polling events"
    default 20
    range 1 100
    depends on PMW3360_INTERRUPT_POLLING
    help
      Maximum number of polling events triggered by a single motion interrupt.

config PMW3360_INTERRUPT_DIRECT_DELAY_MS
    int "Delay in milliseconds for direct interrupt handling"
    default 15
    range 0 100
    depends on PMW3360_INTERRUPT_DIRECT
    help
      Delay before processing the interrupt in direct interrupt handling mode.
      Helps to avoid overwhelming the ble system with mouse movement events.

config PMW3360_CPI
    int "PMW3360's default CPI"
    default 1600
    range 100 12000
    help
      Default CPI value for the sensor

config PMW3360_CPI_DIVISOR
    int "PMW3360's default CPI divisor"
    default 4
    range 1 12
    help
      Default CPI divisor value.

config PMW3360_CPI_STEP
    int "CPI adjustment step size"
    default 200
    range 100 1000
    help
      Step size for CPI increase/decrease operations.
      When using CPI inc/dec behaviors, the CPI will change by this amount.

config PMW3360_SCROLL_CPI
    int "PMW3360's CPI in scroll mode"
    default 3000
    range 100 12000
    help
      Scroll CPI value for the sensor

config PMW3360_SCROLL_CPI_DIVISOR
    int "PMW3360's CPI divisor in scroll mode"
    default 4
    range 1 12
    help
      Scroll CPI divisor value.

config PMW3360_SCROLL_CPI_STEP
    int "Scroll mode CPI adjustment step size"
    default 200
    range 100 500
    help
      Step size for scroll mode CPI adjustments.

config PMW3360_SNIPE_CPI
    int "PMW3360's CPI in snipe mode"
    default 2000
    range 200 3000
    help
      Snipe CPI value for the sensor

config PMW3360_SNIPE_CPI_DIVISOR
    int "PMW3360's CPI divisor in snipe mode"
    default 10
    range 1 12
    help
      Snipe CPI divisor value.

config PMW3360_SNIPE_CPI_STEP
    int "Snipe mode CPI adjustment step size"
    default 100
    range 100 500
    help
      Step size for snipe mode CPI adjustments.

config PMW3360_RUN_DOWNSHIFT_TIME_MS
    int "PMW3360's default RUN mode downshift time"
    default 500
    range 10 2550
    help
      Default RUN mode downshift down time in milliseconds.
      Time after which sensor goes from RUN to REST1 mode.

config PMW3360_REST1_DOWNSHIFT_TIME_MS
    int "PMW3360's default REST1 mode downshift time"
    default 9220
    range 320 81600
    help
      Default REST1 mode downshift down time in milliseconds.
      Time after which sensor goes from REST1 to REST2 mode.

config PMW3360_REST2_DOWNSHIFT_TIME_MS
    int "PMW3360's default REST2 mode downshift time"
    default 150000
    range 3200 816000
    help
      Default REST2 mode downshift down time in milliseconds.
      Time after which sensor goes from REST2 to REST3 mode.

config PMW3360_INVERT_X
    bool "Invert the X axis of PMW3360 sensor"

config PMW3360_INVERT_Y
    bool "Invert the Y axis of PMW3360 sensor"

config PMW3360_ROTATION_ANGLE_DEG
    int "PMW3360's default rotation angle in degree"
    default 0
    range 0 355
    help
      Default rotation angle of the sensor input in degree.


module = PMW3360
module-str = PMW3360
source "${ZEPHYR_BASE}/subsys/logging/Kconfig.template.log_config"

endif #PMW3360
```
